## main/Kconfig.projbuild
```kconfig
menu "Paybox Application Config"

menu "Wifi Config"

config WIFI_SSID
    string "WiFi SSID"
    default "myssid"
    help
        SSID (network name) for the example to connect to.

config WIFI_PASSWORD
    string "WiFi Password"
    default "mypassword"
    help
        WiFi password (WPA or WPA2) for the example to use.

endmenu

menu "Payment Config"

config TIME_COUNT_DOWN
    int "Set time count down"
    default "30"
    help
        Set time count down when wait to scan QR.

menu "ZaloPay Config"

config APP_ID
    string "Set App ID"
    default "222"

config APP_NAME
    string "Set App Name"
    default "PayBox"

config KEY1
    string "Set Key 1"
    default "tzGwJwpUvkDW8p6AgDKECbo1u3vbESHG"

config KEY2
    string "Set Key 2"
    default "key2"

endmenu

endmenu

endmenu
```

## sdkconfig.defaults
```kconfig
CONFIG_HW_CUSTOM=y
CONFIG_HW_M5STACK=
CONFIG_HW_LCD_MOSI_GPIO_CUST=23
CONFIG_HW_LCD_CLK_GPIO_CUST=19
CONFIG_HW_LCD_CS_GPIO_CUST=22
CONFIG_HW_LCD_DC_GPIO_CUST=21
CONFIG_HW_LCD_RESET_GPIO_CUST=18
CONFIG_HW_LCD_BL_GPIO_CUST=15
CONFIG_HW_LCD_SCREEN_WIDTH_CUST=360
CONFIG_HW_LCD_SCREEN_HEIGHT_CUST=320
CONFIG_HW_INV_BL_CUST=y
CONFIG_ESPTOOLPY_PORT="/dev/tty.SLAB_USBtoUART"
CONFIG_ESPTOOLPY_BAUD_OTHER=y
CONFIG_ESPTOOLPY_BAUD_OTHER_VAL=1497600
CONFIG_ESPTOOLPY_COMPRESSED=y

CONFIG_SPIRAM_SUPPORT=
CONFIG_PPP_SUPPORT=y
CONFIG_PPP_PAP_SUPPORT=y
CONFIG_PPP_DEBUG_ON=y
CONFIG_TCPIP_TASK_STACK_SIZE=4096

CONFIG_BT_ENABLED=y
CONFIG_CLASSIC_BT_ENABLED=y
CONFIG_WIFI_ENABLED=n
CONFIG_BT_SPP_ENABLED=y
CONFIG_ESPTOOLPY_FLASHSIZE_4MB=y
CONFIG_PARTITION_TABLE_CUSTOM=y
CONFIG_PARTITION_TABLE_CUSTOM_FILENAME="partitions.csv"
CONFIG_PARTITION_TABLE_FILENAME="partitions.csv"
CONFIG_ENABLE_PERIPH_SPP=y
CONFIG_ENABLE_PERIPH_PPP=y
```
